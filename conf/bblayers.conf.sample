## conf/bblayers.conf.sample
```bitbake
#TODO fazer diretorio generalista

# POKY_BBLAYERS_CONF_VERSION is increased each time build/conf/bblayers.conf
# changes incompatibly
POKY_BBLAYERS_CONF_VERSION = "2"

BBPATH = "${TOPDIR}"
BBFILES ?= ""

BBLAYERS ?= " \
  /home/tambor/raspZero/yocto/poky/meta \
  /home/tambor/raspZero/yocto/poky/meta-poky \
  /home/tambor/raspZero/yocto/poky/meta-yocto-bsp \
  /home/tambor/raspZero/yocto/meta-openembedded/meta-oe \
  /home/tambor/raspZero/yocto/meta-openembedded/meta-multimedia \
  /home/tambor/raspZero/yocto/meta-openembedded/meta-networking \
  /home/tambor/raspZero/yocto/meta-openembedded/meta-python \
  /home/tambor/raspZero/yocto/meta-raspberrypi \
  /home/tambor/raspZero/yocto/meta-tambor \
  "
```

## conf/layer.conf
```bitbake
BBPATH .= ":${LAYERDIR}"

BBFILES += "${LAYERDIR}/recipes-*/*/*.bb \
            ${LAYERDIR}/recipes-*/*/*.bbappend"

BBFILE_COLLECTIONS += "tambor"

BBFILE_PATTERN_tambor = "^${LAYERDIR}/"

BBFILE_PRIORITY_tambor = "10"

LAYERVERSION_tambor = "1"

LAYERSERIES_COMPAT_tambor = "warrior zeus"

#Avoid warning
SANITY_TESTED_DISTROS ?= " \
            ubuntu-19.04 \n \
            ubuntu-19.10 \n \
            "

#Serial console
ENABLE_UART = "1"
```
